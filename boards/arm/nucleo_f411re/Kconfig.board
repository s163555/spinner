## boards/arm/nucleo_f411re/Kconfig.board
```kconfig
# Copyright (c) 2021 Teslabs Engineering S.L.
# SPDX-License-Identifier: Apache-2.0

config BOARD_NUCLEOF411RE
	bool "NUCLEOF411RE"
	depends on SOC_STM32F411XE
```

## boards/arm/nucleo_f411re/Kconfig.defconfig
```kconfig
# Copyright (c) 2021 Teslabs Engineering S.L.
# SPDX-License-Identifier: Apache-2.0

if BOARD_NUCLEOF411RE

config BOARD
	default "nucleof411re"

config FPU
	default y

endif # BOARD_NUCLEOF411RE
```

## boards/arm/nucleo_f411re/nucleo_f411re_defconfig
```kconfig
# Copyright (c) 2021 Teslabs Engineering S.L.
# SPDX-License-Identifier: Apache-2.0

CONFIG_SOC_SERIES_STM32F4X=y
CONFIG_SOC_STM32F411XE=y

CONFIG_PINCTRL=y
CONFIG_GPIO=y
CONFIG_CLOCK_CONTROL=y
```

## spinner/build/Kconfig/Kconfig.modules
```kconfig
menu "spinner (C:/Users/Jeppe/projects/spinner/spinner)"
osource "C:/Users/Jeppe/projects/spinner/spinner/Kconfig"
config ZEPHYR_SPINNER_MODULE
	bool
	default y
endmenu
```

## spinner/build/Kconfig/Kconfig.shield
```kconfig
osource "C:/Users/Jeppe/projects/spinner/spinner/boards/shields/*/Kconfig.shield"
```
